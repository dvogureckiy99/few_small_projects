// LAB_4.cpp: определяет точку входа для консольного приложения.
//

//#define _CRT_SECURE_NO_WARNINGS
#include "stdafx.h"
#include <stdio.h>
#include <iostream>
#include <conio.h> //библиотека содержит функции для работы с экраном
#include <cstring>
#include <string.h>


#define OUTPUT_STRING "МОЁ ИМЯ ДИМА" //Выводимая строка (обязательно прописными буквами !!!)
#define HALF_PERIOD 555 // Т/2 в мксек
#define TIME_DOT 500 // длительность точки в мс  (·)
#define TIME_DASH 1500 //длительность тире в мс  (-)
#define DELAY_BETWEEN_CHARACTERS 500 // интервал между выводом символов кода морзе в мс ( )
#define DELAY_BETWEEN_LETTERS 1000// задержка между выводом букв в слове в мс (  )
#define DELAY_BETWEEN_WORDS 2000 //задержка между выводом слов в строке в мс


using namespace std;

int main(void)
{
	setlocale(LC_CTYPE, "rus");
	//DDRB = 1<<4; 
	//char* output_string = OUTPUT_STRING;
	unsigned int i;
	unsigned char j;
	const char output_string[] = OUTPUT_STRING;
	char coded_string[] = "";
	//в переменной массива последний символ "\0" !!!

	char LiteralsRus[32][] = { "А", "Б", "В", "Г", "Д", "Е", "Ж", "З", "И",
		"Й", "К", "Л", "М", "Н", "О", "П", "Р", "С",
		"Т", "У", "Ф", "Х", "Ц", "Щ", "Ы", "Ь", "Ч",
		"Ш", "Э", "Ю", "Я", "Ё" };
	const char LiteralCodes[32][] = { "· –", "– · · ·", "· – –", "– – ·",
		"– · ·", "·", "· · · –", "– – · ·",
		"· ·", "· – – –", "– · –", "· – · ·",
		"– –", "– ·", "– – –", "· – – ·",
		"· – ·", "· · ·", "–", "· · –",
		"· · – ·", "· · · ·", "– · – ·",
		"– – · –", "– · – –", "– · · –",
		"– – – ·", "– – – – ", "· · – · ·",
		"· · – –", "· – · –","·" };


	//перевод строки в кодировку азбукой Морза
	for (i = 0; i <= strlen(output_string); i++)
	{
		for (j = 0; j <= strlen(LiteralsRus[][0]); j++);
		{
			if (coded_string[j] == LiteralsRus[j][0])
			{
				strncat(coded_string, LiteralCodes[j][], strlen(LiteralCodes[j][]); //добавляем к конечной строке код символа в азбуке морза 
			}

		}


		cout << output_string << endl;
		cout << *(coded_string) << endl;
		_getch(); //функция ввода символа с клавиатуры. Используется для задержки


		return 0;
	}
}
